## Kconfig
```kconfig
source "toolchain/Kconfig"

menu "Output"

config OUT_TAR
       bool "Generate a tarball"

       help
	 Generate a root filesystem tarball. Enabling this option
	 requires tar to be installed.

config OUT_NFS
       bool "Generate an NFS root filesystem"

       help
	 Generate root filesystem for mounting over NFS. Note that
	 this option uses an rsync daemon to be run as super user,
	 launched with sudo. So, in order for this option to work, you
	 will need to be sudoer at least for the rsync command. You
	 will also need hexdump to generate the rsync daemon password.

if OUT_NFS

config OUT_RSYNCD_PORT
       int "Rsync daemon port start"
       range 0 65535
       default 31000

       help
	 NFS root filesystem uses an rsync daemon running as
	 root. This configuration option allows to choose at what port
	 the daemon will start to try running.

endif

config OUT_INITRAMFS
       bool "Generate a cpio archive suitable for an initramfs"

       help
	 Generate a cpio archive, with options suitable for use by the
	 Linux kernel as an initramfs.

if OUT_INITRAMFS

choice
	prompt "Compression"

config OUT_INITRAMFS_GZ
	bool "Gzip"

config OUT_INITRAMFS_XZ
	bool "Xz"

endchoice

config OUT_INITRAMFS_UBOOT
       bool "Prepare the initramfs for U-boot"

       help
	 Run mkimage to prepare the initramfs image for loading with U-boot.

if OUT_INITRAMFS_UBOOT

config OUT_INITRAMFS_UBOOT_LOADADDR
       string "Initramfs load address"
       default ""
       help
	 It is necessary to pass the initramfs load address to u-boot mkimage
	 tool

endif

endif

config OUT_TFTP
	bool "Copy generated files in a tftp directory"

	help
	  Copy the generated files in a tftp directory, for network boot.

if OUT_TFTP

config OUT_TFTP_DIRNAME
        string "tftp directory name"
	default "/var/lib/tftpboot/$(MKR_BOARD)"

	help
	  Choose where to install files. If the path is of the form
	  servername:path, scp will be used to copy files.

config OUT_TFTP_BASENAME
	string "Copied files basename"
	default "mkrootfs"

	help
	  Choose the basename of the installed files. Kernel name will be
	  prefixed with kernel-, initramfs with initramfs- and device tree file
	  with dtb-.

endif

config SKIP_ROOTFS
       bool "Skip reduced root filesystem generation"
       default y

       help
	 With this option disabled, mkrootfs works in two steps: it
	 generates a "staging" directory where all files of all
	 packages are installed, with debug symbols, then a "rootfs"
	 directory which contains only stripped files which will be
	 needed at run-time.

	 Enabling this option will skip the generation of the "rootfs"
	 directory. This speeds-up compilation in cases like using an
	 NFS root filesystem when the size of the root filesystem does
	 not matter.

	 Note that if you do not enable this option, you will need the
	 strip tool provided by the toolchain you use.

if !SKIP_ROOTFS

config SKIP_ROOTFS_MODULES_STRIP
       bool "Skip stripping kernel modules"
       default y

       help
	 This option avoids stripping kernel modules. This eases debugging,
	 as with stripped modules, kernel backtraces get the wrong symbol
	 names.

endif

endmenu

menu "Base"

config SRC_BASEDIR
	string "Package source trees search path"
	default "$(HOME)/src:/usr/src"

	help
	  The list of directories, separated by columns, under which
	  the packages source trees will be looked for. If relative,
	  it is relative to Mkrootfs directory.

source "base/Kconfig"
source "busybox/Kconfig"
source "dropbear/Kconfig"
source "linux/Kconfig"
source "ltp-old/Kconfig"
source "ltp/Kconfig"
source "rtnet/Kconfig"
source "tests/Kconfig"
source "xenomai/Kconfig"

endmenu

menu "Other"

source "alsa-utils/Kconfig"
source "bash/Kconfig"
source "cryptsetup/Kconfig"
source "debootstrap/Kconfig"
source "device-mapper/Kconfig"
source "dialog/Kconfig"
source "dosfstools/Kconfig"
source "e2fsprogs/Kconfig"
source "file/Kconfig"
source "gdb/Kconfig"
source "iperf/Kconfig"
source "kexec-tools/Kconfig"
source "make/Kconfig"
source "mdadm/Kconfig"
source "msr-tools/Kconfig"
source "ntfs-3g/Kconfig"
source "parted/Kconfig"
source "pciutils/Kconfig"
source "rpcbind/Kconfig"
source "strace/Kconfig"
source "tcpdump/Kconfig"
source "usbutils/Kconfig"
source "valgrind/Kconfig"
source "wireless-tools/Kconfig"
source "wpa_supplicant/Kconfig"

endmenu


menu "Libraries"

source "alsa-lib/Kconfig"
source "fuse/Kconfig"
source "libpcap/Kconfig"
source "libtirpc/Kconfig"
source "libtomcrypt/Kconfig"
source "libtommath/Kconfig"
source "libusb/Kconfig"
source "ncurses/Kconfig"
source "popt/Kconfig"
source "readline/Kconfig"
source "util-linux/Kconfig"
source "xz/Kconfig"
source "zlib-ng/Kconfig"

endmenu
```

## alsa-lib/Kconfig
```kconfig
menu "alsa-lib"

config ALSA_LIB
	package "alsa-lib library"

if ALSA_LIB

config ALSA_LIB_SRCDIR
       srcdir "Source directory"
       default "alsa-lib-*"

endif

endmenu
```

## alsa-utils/Kconfig
```kconfig
menu "alsa-utils"

config ALSA_UTILS
	build_select ALSA_LIB
	package "alsa-utils tools"

if ALSA_UTILS

config ALSA_UTILS_SRCDIR
       srcdir "Source directory"
       default "alsa-utils-*"

config ALSA_UTILS_ALSAMIXER
       bool "Enable alsamixer"
       build_select NCURSES

endif

endmenu
```

## bar/Kconfig
```kconfig
menuconfig BAR
	package "bar"
	select FOO

if BAR

config BAR_SRCDIR
	srcdir "Sources directoy"
	default "bar-[0-9]*"

endif
```

## base/Kconfig
```kconfig
menu "Base skeleton"

config BASE
	package
	default y

if BASE

config BASE_SRCDIR
       srcdir
       default "$(srctree)/boards/$(MKR_BOARD)"

config BOARD
	string "Board directory name"
	default "generic"
	help
	  Directory where architecture or board specific files will be taken.
	  This is a path relative to the boards directory in mkrootfs tree.

config KEYBOARD_MAPS
       bool "Keyboard maps"
       help
	 Choose this option if you intend to use the console on
	 virtual terminal instead of serial port and the default
	 qwerty keyboard map does not suit the keyboard.

if KEYBOARD_MAPS

choice
	prompt "Keyboard maps to install"

config KEYBOARD_ONE_MAP
       bool "Install only one keyboard map"
       help
	 Choose this option if you know in advance what map you will
	 need on the device.

config KEYBOARD_ALL_MAPS
       bool "Install all keyboard maps"
       help
	 Choose this option to copy all the keyboard maps in the
	 resulting rootfs, allowing the user to choose the map to use.

endchoice

if KEYBOARD_ONE_MAP

config KEYBOARD_MAP_NAME
	string "Keyboard map name"
	default "fr-latin9"
	help
	  Name of the default keymap to install.

endif

if KEYBOARD_ALL_MAPS

config KEYBOARD_CHOOSER
       bool "Install keymap chooser"
       select DIALOG
       help
	 Install a dialog application allowing to choose the keyboard
	 map.

endif

endif

config SECURE_NETWORK
       bool "Improve network access security"
       help
	 Do not start telnet server, and disable ssh login with empty root
 	 password.

if SECURE_NETWORK

choice
	prompt "SSH server"

config BASE_SSH_DROPBEAR
	select DROPBEAR
	bool "Dropbear"

config BASE_SSH_OPENSSH
	select OPENSSH
	bool "OpenSSH"

endchoice

endif

config SWAP
	bool "Enable swap file on storage device"
	help
	  Add a swap file on a storage device on target.
	  This may be useful for enlarging virtual memory
	  when running tests. This does not destroy the contents
	  of the storage device.

if SWAP

config SWAP_DEV
	string "Storage device name"
	default "sda1"
	help
	  Enter the device name here, without /dev.
endif

if !SWAP

config SWAP_DEV
	default "null"

endif

config BASE_SHELL
       string
       default "/bin/ash" if !BASH
       default "/bin/bash" if BASH

endif

endmenu
```

## bash/Kconfig
```kconfig
menu "Bash"

config BASH
	build_select READLINE
	package "Bash shell"

if BASH

config BASH_SRCDIR
       srcdir "Source directory"
       default "bash-*"

endif

endmenu
```

## busybox/Kconfig
```kconfig
menu "BusyBox"

config BUSYBOX
	package
	default y

if BUSYBOX

config BUSYBOX_SRCDIR
	srcdir "Source directory"
	default "busybox-*"

choice
	prompt "Configuration file"

config BUSYBOX_BOARD_DEFCONFIG
	bool "Use busybox defconfig"
	help
	  Use busybox defconfig file.

config BUSYBOX_BOARD_CONFIG
	bool "From board directory"
	help
	  Use the file named busybox-config in the boards/$(MKR_BOARD_NAME)
	  directory in mkrootfs tree.

endchoice

endif

endmenu
```

## cryptsetup/Kconfig
```kconfig
menu "Cryptsetup"

config CRYPTSETUP
	package "Cryptsetup"
	build_select UTIL_LINUX
	build_select DEVICE_MAPPER
	build_select POPT

if CRYPTSETUP

config CRYPTSETUP_SRCDIR
       srcdir "Source directory"
       default "cryptsetup-*"

config CRYPTSETUP_LIBUUID
       def_bool y
       select UTIL_LINUX_LIBUUID

endif

endmenu
```

## debootstrap/Kconfig
```kconfig
menu "Debootstrap"

config DEBOOTSTRAP
	package "Debootstrap tool"

if DEBOOTSTRAP

config DEBOOTSTRAP_SRCDIR
       srcdir "Source directory"
       default "debootstrap-*"

endif

endmenu
```

## device-mapper/Kconfig
```kconfig
menu "Device Mapper"

config DEVICE_MAPPER
	package "Device Mapper tool"

if DEVICE_MAPPER

config DEVICE_MAPPER_SRCDIR
       srcdir "Source directory"
       default "LVM*"

endif

endmenu
```

## dialog/Kconfig
```kconfig
menu "Dialog"

config DIALOG
	package "Dialog tool"
	build_select NCURSES

if DIALOG

config DIALOG_SRCDIR
       srcdir "Source directory"
       default "dialog-*"

config DIALOG_WIDEC
       depends on !READLINE
       select NCURSES_WIDEC
       bool "Enable wide characters support"

endif

endmenu
```

## dosfstools/Kconfig
```kconfig
menu "Dosfstools"

config DOSFSTOOLS
	package "Dosfstools filesystem utilities"

if DOSFSTOOLS

config DOSFSTOOLS_SRCDIR
       srcdir "Source directory"
       default "dosfstools-*"

endif

endmenu
```

## dropbear/Kconfig
```kconfig
menu "Dropbear"

config DROPBEAR
	package "Dropbear embedded ssh client/server"
	select LIBUTIL
	build_select LIBTOMMATH
	build_select LIBTOMCRYPT

if DROPBEAR

config DROPBEAR_SRCDIR
       srcdir "Source directory"
       default "dropbear-*"

config DROPBEAR_ZLIB
       bool "Enable zlib compression"
       build_select ZLIB

endif

endmenu
```

## e2fsprogs/Kconfig
```kconfig
menu "E2fsprogs"

config E2FSPROGS
	package "E2fsprogs filesystem utilities"

if E2FSPROGS

config E2FSPROGS_SRCDIR
       srcdir "Source directory"
       default "e2fsprogs-*"

config E2FSPROGS_LIBUUID
       def_bool UTIL_LINUX_LIBUUID
       build_depends on UTIL_LINUX

config E2FSPROGS_LIBBLKID
       def_bool UTIL_LINUX_LIBBLKID
       build_depends on UTIL_LINUX

endif

endmenu
```

## file/Kconfig
```kconfig
menu "File"

config FILE
	package "The file utility"

if FILE

config FILE_SRCDIR
       srcdir "Source directory"
       default "file-*"

config FILE_ZLIB
       bool "Enable zlib compression"
       build_select ZLIB

endif

endmenu
```
