## xenomai/Kconfig
```kconfig
menu "Xenomai"

config XENO
	package "Xenomai"
	default y

if XENO

config XENO_SRCDIR
       srcdir "Source directory"
       default "xenomai-*"

config XENO_MAINT
       bool "Maintainer mode"
       help
	 Enabling this option will cause the build system to account
	 for file additions in the Xenomai sources tree, at the
	 expense of a larger compilation time (especially the kernel).

config XENO_SMP
       bool "SMP libraries"
       default y if ARCH_X86_64
       help
	 Choose 'y' here to build libraries for multi-processor systems.

config XENO_KERNEL
       def_bool n

choice
	prompt "Xenomai version"

config XENO_CLASSIC
       bool "Xenomai v2.x"
       select XENO_KERNEL

config XENO_FORGE
       bool "Xenomai forge (v3.x)"

endchoice

if XENO_FORGE

choice
       prompt "Xenomai core used"

config XENO_COBALT
       bool "Cobalt"
       select XENO_KERNEL

config XENO_MERCURY
       bool "Mercury"
       build_select FUSE
endchoice

config XENO_VALGRIND
       bool "Enable valgrind client API"
       build_select VALGRIND

choice
	prompt "Debug level"

config XENO_DEBUG_NONE
       bool "Compile without any debugging"

config XENO_DEBUG_SYMBOLS
       bool "Compile with debug symbols"

config XENO_DEBUG_PARTIAL
       bool "Compile with partial debugging enabled"

config XENO_DEBUG_FULL
       bool "Compile with full debugging enabled"
endchoice
endif

if XENO_CLASSIC
config XENO_DEBUG
       bool "Enable debug symbols"
       default y

endif

menu "Components selection"

config XENO_USERSPACE
       def_bool n

config XENO_A4L
       bool "Install analogy libraries and utilities"
       select XENO_USERSPACE

config XENO_NATIVE
       bool "Install native skin library"
       default y
       select XENO_USERSPACE

config XENO_POSIX
       bool "Install POSIX skin library"
       default y
       select XENO_USERSPACE

config XENO_PSOS
       bool "Install PSOS skin library"
       select XENO_USERSPACE

config XENO_RTCAN
       bool "Install RT socket CAN utilities"
       select XENO_USERSPACE

config XENO_RTDM
       bool "Install RTDM skin library"
       default y
       select XENO_USERSPACE

config XENO_UITRON
       bool "Install UITRON skin library"
       select XENO_USERSPACE

config XENO_VRTX
       bool "Install VRTX skin library"
       select XENO_USERSPACE

config XENO_VXWORKS
       bool "Install VxWorks skin library"
       select XENO_USERSPACE

config XENO_TESTSUITE
       bool "Install testsuite"
       select XENO_NATIVE
       select XENO_POSIX
       select XENO_RTDM
       default y
       help
	 Install the basic testsuite.

config XENO_TESTSUITE_UNFREQUENT
       bool "Install tests used less frequently"
       select XENO_TESTSUITE
       help
	 Install less frequently used tests requiring special kernel
	 drivers:
	 - irqbench
       	 - klatency
	 - rtdmtest
	 - sigtest

endmenu

menu "Advanced configuration options"

config XENO_SEP_TESTDIR
       bool "Separated tests directory"

config XENO_TESTDIR
       depends on XENO_SEP_TESTDIR
       string "Tests directory"

if XENO_KERNEL && (ARCH_X86_32 || ARCH_X86_64)

config XENO_X86_VSYSCALL
       bool "Use vsyscall support in Xenomai libraries"
       default y

config XENO_X86_TSC
       bool "Use x86 TSC in Xenomai libraries"
       default y

endif

config XENO_THREAD
       bool "Use TLS in Xenomai libraries"
       default n
       help
	 This option enables the use of thread local data in Xenomai
	 code using the __thread keyword. This may save a few
       	 processor instructions in a few places, but may trigger
       	 compiler bugs.

config XENO_DLOPEN
       bool "Allow loading Xenomai skin libraries with dlopen"
       depends on !XENO_THREAD

menu "Automatic mlockall"

config XENO_POSIX_MLOCKALL
       bool "Automatic mlockall for POSIX skin"

config XENO_PSOS_MLOCKALL
       bool "Automatic mlockall for PSOS+ skin"

config XENO_UITRON_MLOCKALL
       bool "Automatic mlockall for UITRON skin"

endmenu

choice
	prompt "Atomic instructions type"

config XENO_ATOMIC_BUILTINS
       bool "Use GCC builtins for atomic instructions"

config XENO_ATOMIC_ADHOC
       bool "Use ad-hoc inlines for atomic instructions"

endchoice

if XENO_FORGE

config XENO_FORGE_MONOTONIC_RAW
       bool "Use CLOCK_MONOTONIC_RAW for timings"

config XENO_FORGE_REGISTRY
       bool "Enable export of real-time objects to a registry"
       build_select FUSE

config XENO_FORGE_LORES_CLOCK
       bool "Enable low resolution clock"

config XENO_FORGE_ASSERT
       bool "Enable run-time assertions"

config XENO_FORGE_ASYNC_CANCEL
       bool "Enable asynchronous cancellation"

config XENO_FORGE_PSHARED
       bool "Enable shared multi-processing for capable skins"

endif

endmenu

if ARCH_ARM

config XENO_ARM_MACH
       string "ARM Machine to build Xenomai for"
       default "generic"
       help
	 This string is passed to the --enable-arm-mach option of
	 Xenomai configure script. Run this script with the --help
	 option to see the available machines.

endif

endif

endmenu
```

## xz/Kconfig
```kconfig
menu "xz"

config XZ
	package "Xz compression library and tool"

if XZ

config XZ_SRCDIR
       srcdir "Source directory"
       default "xz-*"

config XZ_XZ
       bool "Install xz"
       help
	This installs the xz tools in addition to the liblzma library.
	Note that some xz tools conflict with busybox, so, you have to
        disable these tools in busybox if you want the versions from
	the xz package.

endif

endmenu
```

## zlib-ng/Kconfig
```kconfig
menu "zlib-ng"

config ZLIB
	package "Zlib compression library"

if ZLIB

config ZLIB_NG_SRCDIR
       srcdir "Source directory"
       default "zlib-ng*"

endif

endmenu
```
