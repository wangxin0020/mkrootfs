## msr-tools/Kconfig
```kconfig
menu "msr-tools"

config MSR_TOOLS
       depends on ARCH_X86_32 || ARCH_X86_64
       package "MSR tools"

if MSR_TOOLS

config MSR_TOOLS_SRCDIR
       srcdir "Source directory"
       default "msr-tools-*"

endif

endmenu
```

## ncurses/Kconfig
```kconfig
menu "ncurses"

config NCURSES
	package "NCURSES support"
	default n

if NCURSES

config NCURSES_SRCDIR
       srcdir "Source directory"
       default "ncurses-*"

config NCURSES_WIDEC
       depends on !READLINE
       bool "Enable wide characters support"

config NCURSES_FULL_TERMINFO
       bool "Install full terminfo database"

endif

endmenu
```

## netcat/Kconfig
```kconfig
menu "Netcat"

config NETCAT
	package "Netcat tool"

if NETCAT

config NETCAT_SRCDIR
       srcdir "Source directory"
       default "netcat-*"

endif

endmenu
```

## ntfs-3g/Kconfig
```kconfig
menu "Ntfs-3g"

config NTFS
	package "Ntfs-3g tools"
	build_select FUSE
	build_select UTIL_LINUX

if NTFS

config NTFS32
       bool
       default FUSE32

config NTFS_SRCDIR
       srcdir "Source directory"
       default "ntfs-3g_*"

config NTFS_LIBUUID
       def_bool y
       select UTIL_LINUX_LIBUUID


endif

endmenu
```

## openssh/Kconfig
```kconfig
menu "OpenSSH"

config OPENSSH
       select LIBUTIL
       build_select ZLIB
       build_select LIBRESSL
       package "OpenSSH"

if OPENSSH

config OPENSSH_SRCDIR
       srcdir "Source directory"
       default "openssh-*"

endif

endmenu
```

## parted/Kconfig
```kconfig
menu "Parted"

config PARTED
	package "Parted tool"
	build_select UTIL_LINUX
	build_select DEVICE_MAPPER

if PARTED

config PARTED_SRCDIR
       srcdir "Source directory"
       default "parted-*"

config PARTED_LIBBLKID
       def_bool y
       select UTIL_LINUX_LIBBLKID

endif

endmenu
```

## pciutils/Kconfig
```kconfig
menu "pciutils"

config PCIUTILS
       package "PCI utilities"

if PCIUTILS

config PCIUTILS_SRCDIR
       srcdir "Source directory"
       default "pciutils-*"

config PCIUTILS_ZLIB
       bool "Enable zlib compression"
       build_select ZLIB

endif

endmenu
```

## popt/Kconfig
```kconfig
menu "popt"

config POPT
	package "POPT support"
	default n

if POPT

config POPT_SRCDIR
       srcdir "Source directory"
       default "popt-*"

endif

endmenu
```

## qux/Kconfig
```kconfig
menu "qux"

config QUX
	package "qux"
	depends on BAR

if QUX

config QUX_SRCDIR
	srcdir "Sources directory"
	default "qux-[0-9]*"

endif

endmenu
```

## readline/Kconfig
```kconfig
menu "readline"

config READLINE
	build_select NCURSES
	package "Readline library"

if READLINE

config READLINE_SRCDIR
       srcdir "Source directory"
       default "readline-*"

endif

endmenu
```

## rpcbind/Kconfig
```kconfig
menu "Rpcbind"

config RPCBIND
	package "Rpcbind"
	build_select LIBTIRPC

if RPCBIND

config RPCBIND_SRCDIR
       srcdir "Source directory"
       default "rpcbind-*"

endif

endmenu
```

## rtnet/Kconfig
```kconfig
menu "RTnet"

config RTNET
	package "RTnet (old)"
	depends on XENO_CLASSIC
	build_depends on LINUX
	build_depends on XENO

	help
	  This allows building RTnet with some preset configuration for 
	  Xenomai 2.x, for rapidly testing for regressions between in Xenomai
	  3.x. If you are looking for a really configurable RTnet, you should
	  install Xenomai 3.x.

if RTNET

config RTNET_SRCDIR
       srcdir "Source directory"
       default "rtnet-*"

endif

endmenu
```

## strace/Kconfig
```kconfig
menu "Strace"

config STRACE
	package "Strace tool"
	depends on !ARCH_BFIN
	default y

if STRACE

config STRACE_SRCDIR
       srcdir "Source directory"
       default "strace-*"

config STRACE_AIO
       bool "Enable aio decoding"
       build_select LIBAIO

endif

endmenu
```

## tcpdump/Kconfig
```kconfig
menu "Tcpdump"

config TCPDUMP
	build_select LIBPCAP
	package "Tcpdump network capture tool"

if TCPDUMP

config TCPDUMP_SRCDIR
       srcdir "Source directory"
       default "tcpdump-*"

endif

endmenu
```

## tests/Kconfig
```kconfig
menu "Real-time tests & benches"

config TESTS
	package "Real-time tests"
	select NETCAT
	build_depends on LINUX
	help
	  This packages contains a few binaries  which is necessary to
	  run tests and benches on a real-time system. You should enable
	  the ltp package if you want to use the "dohell" test.

if TESTS

config TESTS_SRCDIR
       srcdir
       default "$(srctree)/tests"

config TESTS_XENO
       def_bool y
       build_depends on XENO
       select XENO_TESTSUITE

if TESTS_XENO

config XENO_TEST_FRONTEND
       bool "Install interactive xeno-test frontend"
       select DIALOG

endif

config TESTS_LTP
       def_bool y
       depends on LTP

endif

endmenu
```

## toolchain/Kconfig
```kconfig
menu "Toolchain and flags selection"

config TOOLCHAIN
	package
	default y

if TOOLCHAIN

choice
	prompt "Architecture"

config ARCH_ARM
	bool "arm"

config ARCH_BFIN
	bool "blackfin"

config ARCH_NIOS2
	bool "nios2"

config ARCH_PPC32
	bool "powerpc 32 bits"

config ARCH_PPC64
	bool "powerpc 64 bits"

config ARCH_I386
	bool "i386"

config ARCH_X86_32
	bool "x86 32 bits"

config ARCH_X86_64
	bool "x86 64 bits"

config ARCH_SH4
	bool "SH-4"

endchoice

config ARCH
	string
	default "arm" if ARCH_ARM
	default "bfin" if ARCH_BFIN
	default "nios2" if ARCH_NIOS2
	default "ppc" if ARCH_PPC32
	default "ppc64" if ARCH_PPC64
	default "sh4" if ARCH_SH4
	default "i686" if ARCH_X86_32
	default "i686" if ARCH_I386
	default "x86_64" if ARCH_X86_64

config KARCH
	string
	default "arm" if ARCH_ARM
	default "blackfin" if ARCH_BFIN
	default "i386" if ARCH_I386
	default "nios2" if ARCH_NIOS2
	default "powerpc" if ARCH_PPC32 || ARCH_PPC64
	default "sh" if ARCH_SH4
	default "x86" if ARCH_X86_32 || ARCH_X86_64

if ARCH_X86_64

config ARCH32
       string
       default "i686" if ARCH_X86_64

endif

config HAVE_TOOLCHAIN32
       def_bool ARCH_X86_64

config CONFIGURE_HOST
	string "Configure host string"
	default "$(ARCH)-linux"
	help
	  String passed to the --host argument of configure scripts

config CC
	string "Cross-compiler"
	default "$(ARCH)-linux-gcc"

config CXX
	string "C++ Cross-compiler"
	default "$(ARCH)-linux-g++"

config ARCH_FLAGS
	string
	default "-march=armv4t -msoft-float" if ARM_ARCH = 4
	default "-march=armv5te -msoft-float" if ARM_ARCH = 5 && ARM_FLOAT_SOFT
	default "-march=armv5te -mfpu=vfp $(ARM_VFP_ABI)" if ARM_ARCH = 5 && ARM_FLOAT_VFP2
	default "-march=armv6 -msoft-float" if ARM_ARCH = 6 && ARM_FLOAT_SOFT
	default "-march=armv6 -mfpu=vfp $(ARM_VFP_ABI)" if ARM_ARCH = 6 && ARM_FLOAT_VFP2
	default "-march=armv7-a -msoft-float" if ARM_ARCH = 7 && ARM_FLOAT_SOFT
	default "-march=armv7-a -mfpu=vfp3 $(ARM_VFP_ABI)" if ARM_ARCH = 7 && ARM_FLOAT_VFP3
	default "-march=armv7-a -mfpu=vfp3-d16 $(ARM_VFP_ABI)" if ARM_ARCH = 7 && ARM_FLOAT_VFP3_D16
	default "-march=armv7-a -mfpu=neon $(ARM_VFP_ABI)" if ARM_ARCH = 7 && ARM_FLOAT_NEON
	default "-march=armv7-a -mfpu=vfp4 $(ARM_VFP_ABI)" if ARM_ARCH = 7 && ARM_FLOAT_VFP4
	default "-march=armv7-a -mfpu=vfp4-d16 $(ARM_VFP_ABI)" if ARM_ARCH = 7 && ARM_FLOAT_VFP4_D16
	default "-m32" if ARCH_X86_32

if ARCH_ARM

config ARM_ARCH
	int "ARM architecture"
	range 4 7
	default 5

choice
	prompt "Floating points support"
	default ARM_FLOAT_VFP2 if ARM_ARCH = 6
	default ARM_FLOAT_VFP3 if ARM_ARCH = 7
	default ARM_FLOAT_SOFT if ARM_ARCH = 4 || ARM_ARCH = 5

config ARM_FLOAT_SOFT
	bool "Soft-float"

if ARM_ARCH = 5 || ARM_ARCH = 6

config ARM_FLOAT_VFP2
	bool "VFP2 hard float"

endif

if ARM_ARCH = 7

config ARM_FLOAT_VFP3
	bool "VFP3 hard float"

config ARM_FLOAT_VFP3_D16
	bool "VFP3-D16 hard float"

config ARM_FLOAT_NEON
	bool "NEON hard float"

config ARM_FLOAT_VFP4
	bool "VFP4 hard float"

config ARM_FLOAT_VFP4_D16
	bool "VFP4-D16 hard float"

endif

endchoice

config ARM_FLOAT_VFP
       def_bool !ARM_FLOAT_SOFT

config CFLAGS
	string "C Compilation flags"
	default "$(ARCH_FLAGS) -g -Os"

config CXXFLAGS
	string "C++ Compilation flags"
	default "$(ARCH_FLAGS) -g -Os"

config LDFLAGS
	string "Link flags"
	default "$(ARCH_FLAGS) -g -Os"

endif

if !ARCH_ARM

config CFLAGS
	string "C Compilation flags"
	default "$(ARCH_FLAGS) -g -O2"

config CXXFLAGS
	string "C++ Compilation flags"
	default "$(ARCH_FLAGS) -g -O2"

config LDFLAGS
	string "Link flags"
	default "$(ARCH_FLAGS) -g -O2"

endif

choice
	prompt "Toolchain sysroot"
	default SYSROOT_AUTO

config SYSROOT_AUTO
       bool "Automatic"
       help
	 Try and guess toolchain sysroot automatically. If you get an
	 error at the configuration check step, choose SYSROOT_MANUAL,
	 and set SYSROOT to where the toolchain sysroot is.

config SYSROOT_MANUAL
       bool "Manual"

endchoice

if SYSROOT_MANUAL

config SYSROOT
       string "sysroot location"

endif

if HAVE_TOOLCHAIN32

config TOOLCHAIN32
       bool "Enable use of 32 bits toolchain"

if TOOLCHAIN32

config CONFIGURE_HOST32
	string "Configure 32 bits version host string"
	default "$(ARCH32)-linux"
	help
	  String passed to the --host argument of configure scripts

config CC32
	string "32 bits Cross-compiler"
	default "$(CC) -m32"

config CXX32
	string "32 bits C++ Cross-compiler"
	default "$(CXX) -m32"

choice
	prompt "32 bits Toolchain sysroot"
	default SYSROOT32_AUTO

config SYSROOT32_AUTO
       bool "Automatic"
       help
	 Try and guess toolchain sysroot automatically. If you get an
	 error at the configuration check step, choose SYSROOT32_MANUAL,
	 and set SYSROOT to where the toolchain sysroot is.

config SYSROOT32_MANUAL
       bool "Manual"

endchoice

if SYSROOT32_MANUAL

config SYSROOT32
       string "32 bits sysroot location"

endif

endif

endif

menu "Toolchain libraries selection"

config LIBDL
       bool "Install libdl"
       default y

config LIBM
       bool "Install libm"
       default y

config LIBPTHREAD
       bool "Install libpthread"
       default y

config LIBRESOLV
       bool "Install name resolution libraries"
       default y

config LIBSTDCPP
       bool "Install libstdc++"
       default n

config LIBUTIL
       bool "Install libutil"
       default n

endmenu

endif

endmenu
```

## usbutils/Kconfig
```kconfig
menu "Usbutils"

config USBUTILS
       build_select BUSYBOX
       build_select LIBUSB
       package "Usb utilities"

if USBUTILS

config USBUTILS_SRCDIR
       srcdir "Source directory"
       default "usbutils-*"

endif

endmenu
```

## util-linux/Kconfig
```kconfig
menu "util-linux"

config UTIL_LINUX
	package "util-linux libraries and tools"

if UTIL_LINUX

config UTIL_LINUX_SRCDIR
       srcdir "Source directory"
       default "util-linux-*"

config UTIL_LINUX_LIBUUID
       bool "Build libuuid"
       help
	 Build the libuuid library. This library is used by several
       	 utilities such as e2fsprogs and gptfdisk.

config UTIL_LINUX_LIBBLKID
       bool "Build libblkid"
       select UTIL_LINUX_LIBUUID
       help
	 Build the libblkid librarry. This library is used by
	 utilities such as e2fsprogs.

config UTIL_LINUX_CRAMFS
       bool "Build cramfs tools"
       help
	 Build the tools (mkfs, fsck) for the CRAMFS filesystem.

endif

endmenu
```

## valgrind/Kconfig
```kconfig
menu "Valgrind"

config VALGRIND
	package "Valgrind"
	default n
	depends on (ARCH_ARM && ARM_ARCH = 7) || ARCH_PPC32 \
		|| ARCH_PPC64 || ARCH_I386 || ARCH_X86_32 || ARCH_X86_64

if VALGRIND

config VALGRIND_SRCDIR
       srcdir "Source directory"
       default "valgrind-*"

endif

endmenu
```

## wireless-tools/Kconfig
```kconfig
menu "wireless-tools"

config WIRELESS_TOOLS
	package "Wireless tools"

if WIRELESS_TOOLS

config WIRELESS_TOOLS_SRCDIR
       srcdir "Source directory"
       default "wireless_tools.*"

endif

endmenu
```

## wpa_supplicant/Kconfig
```kconfig
menu "wpa_supplicant"

config WPA_SUPPLICANT
	package "WPA supplicant"

if WPA_SUPPLICANT

config WPA_SUPPLICANT_SRCDIR
	srcdir "Source directory"
	default "wpa_supplicant-*"

choice
	prompt "TLS library"
	help
	  Choose library used for TLS implementation.

config WPA_SUPPLICANT_TLS_INTERNAL
	bool "Internal (libtommath based)"
	build_select LIBTOMMATH

config WPA_SUPPLICANT_TLS_LIBRESSL
	bool "LibreSSL"
	build_select LIBRESSL

endchoice

config WPA_SUPPLICANT_CONFIG_TLS
	string
	default "internal" if WPA_SUPPLICANT_TLS_INTERNAL
	default "openssl" if WPA_SUPPLICANT_TLS_LIBRESSL

endif

endmenu
```

## xeno-testsuite/Kconfig
```kconfig
menu "Xenomai testsuite"

config XENO_FULL_TESTSUITE
	package "Xenomai testsuite"
	build_depends on XENO

if XENO_FULL_TESTSUITE

config XENO_TESTSUITE_SRCDIR
       srcdir "Source directory"
       default "xeno-testsuite"

endif

endmenu
```
