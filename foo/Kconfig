## foo/Kconfig
```kconfig
menu "foo"

config FOO
	package "foo"

if FOO

config FOO_SRCDIR
srcdir "foo sources directory"
default "foo-[0-9]*"

config FOO_OPT
bool "FOO_OPT"

endif

endmenu
```

## fuse/Kconfig
```kconfig
menu "fuse"

config FUSE
       package	"FUSE support"
       default n

if FUSE

config FUSE32
       bool "build FUSE using 32 bits toolchain"
       depends on HAVE_TOOLCHAIN32

config FUSE_SRCDIR
       srcdir "FUSE directory"
       default "fuse-*"

endif

endmenu
```

## gdb/Kconfig
```kconfig
menu "GDB"

config GDB
        build_select READLINE
	package "GDB debugger"
	default n

if GDB

config GDB_SRCDIR
       srcdir "Source directory"
       default "gdb-*"

config GDB_ZLIB
       bool "Enable zlib compression"
       build_select ZLIB

endif

endmenu
```

## grub-efi/Kconfig
```kconfig
config GRUB_EFI
       package "EFI support for bootable ISO"
       build_depends on OUT_ISO_BOOT
       help
	Generates the necessary contents to allow booting an ISO image on a
        machine with EFI support. It requires the following tools:
	- mtools
	- grub

if GRUB_EFI

config GRUB_EFI_DIR
       srcdir "GRUB x86_64 EFI directory"
       default "/usr/lib64/grub/x86_64-efi"

endif
```

## iperf/Kconfig
```kconfig
menu "Iperf"

config IPERF
	package "Iperf"
	select LIBSTDCPP

if IPERF

config IPERF_SRCDIR
       srcdir "Source directory"
       default "iperf-*"

endif

endmenu
```

## iproute2/Kconfig
```kconfig
menu "iproute2"

config IPROUTE2
	build_select IPTABLES
	package "Iproute2"

if IPROUTE2

config IPROUTE2_SRCDIR
       srcdir "Source directory"
       default "iproute2-*"

endif

endmenu
```

## ipsec-tools/Kconfig
```kconfig
menu "ipsec-tools"

config IPSEC_TOOLS
	select LIBUTIL
	build_select READLINE
	build_select LIBRESSL
	package "Ipsec-Tools"

if IPSEC_TOOLS

config IPSEC_TOOLS_SRCDIR
	srcdir "Source directory"
	default "ipsec-tools-*"

endif

endmenu
```

## iptables/Kconfig
```kconfig
menu "iptables"

config IPTABLES
	build_select LIBNFTNL
	package "Iptables"

if IPTABLES

config IPTABLES_SRCDIR
       srcdir "Source directory"
       default "iptables-*"

endif

endmenu
```

## iso-boot/Kconfig
```kconfig
config OUT_ISO_BOOT
       package "Generate bootable iso"
       select OUT_INITRAMFS
       help
	This pseudo-package generates the necessary contents to generate a
	bootable ISO image. This package requires syslinux to be installed.

if OUT_ISO_BOOT

config OUT_ISO_BOOT_DIR
       srcdir "Syslinux binaries directory"
       default "/usr/share/syslinux"

config OUT_ISO_HYBRID
       bool "Generate hybrid ISO image, bootable via USB"

endif
```

## kexec-tools/Kconfig
```kconfig
menu "Kexec-tools"

config KEXEC_TOOLS
	package "Kexec tools"

if KEXEC_TOOLS

config KEXEC_TOOLS_SRCDIR
       srcdir "Source directory"
       default "kexec-tools-*"

config KEXEC_ZLIB
       bool "Enable zlib compression"
       build_select ZLIB

config KEXEC_LZMA
       bool "Enable lzma compression"
       build_select XZ

config KEXEC_TOOLS_KDUMP
       bool "Install kdump tool"

endif

endmenu
```

## libaio/Kconfig
```kconfig
menu "libaio"

config LIBAIO
       package "libaio library"

if LIBAIO

config LIBAIO_SRCDIR
       srcdir "Source directory"
       default "libaio-*"

endif

endmenu
```

## libmnl/Kconfig
```kconfig
menu "libmnl"

config LIBMNL
	package "Libmnl"

if LIBMNL

config LIBMNL_SRCDIR
       srcdir "Source directory"
       default "libmnl-*"

endif

endmenu
```

## libnftnl/Kconfig
```kconfig
menu "libnftnl"

config LIBNFTNL
	build_select LIBMNL
	package "Libnftnl"

if LIBNFTNL

config LIBNFTNL_SRCDIR
       srcdir "Source directory"
       default "libnftnl-*"

endif

endmenu
```

## libpcap/Kconfig
```kconfig
menu "libpcap"

config LIBPCAP
	package "Libpcap network capture library"

if LIBPCAP

config LIBPCAP_SRCDIR
       srcdir "Source directory"
       default "libpcap-*"

endif

endmenu
```

## libressl/Kconfig
```kconfig
menu "libressl"

config LIBRESSL
	package "LibreSSL"

if LIBRESSL

config LIBRESSL_SRCDIR
       srcdir "Source directory"
       default "libressl-*"

config LIBRESSL_OPENSSL
       bool "Install openssl tool"

endif

endmenu
```

## libtirpc/Kconfig
```kconfig
menu "libtirpc"

config LIBTIRPC
	package "TIRPC library"

if LIBTIRPC

config LIBTIRPC_SRCDIR
       srcdir "Source directory"
       default "libtirpc-*"

endif

endmenu
```

## libtomcrypt/Kconfig
```kconfig
menu "libtomcrypt"

config LIBTOMCRYPT
	package "libtomcrypt library"
	build_select LIBTOMMATH

if LIBTOMCRYPT

config LIBTOMCRYPT_SRCDIR
       srcdir "Source directory"
       default "libtomcrypt-*"

endif

endmenu
```

## libtommath/Kconfig
```kconfig
menu "libtommath"

config LIBTOMMATH
	package "libtommath library"

if LIBTOMMATH

config LIBTOMMATH_SRCDIR
       srcdir "Source directory"
       default "libtommath-*"

endif

endmenu
```

## libusb/Kconfig
```kconfig
menu "libusb"

config LIBUSB
	package "Usb library"

if LIBUSB

config LIBUSB_SRCDIR
       srcdir "Source directory"
       default "libusb-*"

endif

endmenu
```

## linux-firmware/Kconfig
```kconfig
menu "Linux firmware"

config LINUX_FW
	package "Linux firmware"
	help
	  If this option is enabled, binary firmwares will be downloaded from
	  kernel.org git repository

if LINUX_FW

config LINUX_FW_REPO
       string "Git repository URL"
       default "git://git.click-hack.org/kernel.org/linux-firmware.git"
       help
	 Repository to use as source for the firmware binaries.

config LINUX_FW_UPDATE
       bool "Sync repository everytime"
       help
         Enable this option to synchronize with the git repository every time
       	 the package is installed. This probably slows down the compilation, and
       	 should not be very useful as the firmware binaries do not change very
	 often.
endif

endmenu
```

## linux/Kconfig
```kconfig
menu "Linux kernel"

config LINUX
	package
	default y

if LINUX

config KCC
	string "Linux kernel compiler"
	default "$(CC)"

config LINUX_SRCDIR
	srcdir "Sources directory"
	default "linux-*"

choice
	prompt "Configuration file"

config LINUX_BOARD_CONFIG
	bool "From board directory"
	help
	  Use the file named linux-config-$(KERNELVERSION) in the 
	  boards/$(MKR_BOARD_NAME) directory in mkrootfs tree.

config LINUX_BOARD_DEFCONFIG
	bool "Use kernel defconfig"
	help
	  Use a kernel defconfig file (specified with
	  LINUX_BOARD_DEFCONFIG_NAME).

endchoice

config LINUX_BOARD_DEFCONFIG_NAME
	string "Defconfig name"
	depends on LINUX_BOARD_DEFCONFIG
	help
	  Choose the Linux kernel defconfig file name.

config LINUX_TARGETS
	string "Targets"
	default "uImage"
	help
	  Target or list of targets, separated by spaces, to run when compiling
	  the kernel.

config LINUX_IMAGE
	string "Image"
	default "arch/$(KARCH)/boot/uImage"
	help
	  Kernel image to be copied to a boot-loader specific directory.

if ARCH_ARM

config LINUX_LOADADDR
       string "Load address"
       default ""
       help
	 On the ARM platform, with newer multiarch kernels, the load
	 address needs to be passed to the build process to generate
	 an uImage for the target board.

endif

choice
	prompt "Device tree support"

config LINUX_NO_DT
	bool "No device tree support"

config LINUX_DT_MERGED
	bool "Merged device tree support for legacy bootloaders"

config LINUX_DT
	bool "Separated Device tree support for recent bootloaders"

endchoice

if LINUX_DT || LINUX_DT_MERGED

config LINUX_DT_NAME
       string "Board specific device tree file name"
       default ""
       help
	 The name of the dtb file

endif

config LINUX_EXTRA_FILES
	string "Extra output files"
	help
	  Extra board specific output files

config LINUX_EXTRA_INSTALL
	string "Extra output files installation directory"
	help
	  Directory where the output files will be installed. The copy uses
	  scp if this destination has the form host:path or user@host:path.

endif

endmenu
```

## ltp-old/Kconfig
```kconfig
menu "LTP (old versions)"

config LTP_OLD
	package "Linux Testing Project (old versions)"
	select MAKE

	help
	 Note that this package requires lex or flex to be installed.

if LTP_OLD

config LTP_OLD_SRCDIR
       srcdir "Source directory"
       default "ltp-full-*"

config LTP_OLD_MAINT
       bool "Maintainer mode"
       help
	 LTP is copied into the target staging directory before being
	 compiled, so, in order to take into account any modification
	 which would have been made on the sources files, they need to
	 be copied at every compilation. As this is a long operation,
	 and useful only in the rare case where you would like to
       	 modify LTP sources, it is not done by default, but this
       	 option allows to enable it.

endif

endmenu
```

## ltp/Kconfig
```kconfig
menu "LTP (newer versions)"

config LTP_NEW
	package "Linux Testing Project (newer versions)"

	help
	  Older versions of LTP required running "make install" on the
	  board to have the installation working when cross-compiling,
	  which is what LTP_OLD does. Newer versions of LTP do not
	  require this, LTP_NEW is made for these. Note that LTP_OLD
	  will work with any version, whereas LTP_NEW will not work
	  correctly with old versions.

if LTP_NEW

config LTP_NEW_SRCDIR
       srcdir "Source directory"
       default "ltp-full-*"

config LTP_NEW_AIO
       bool "Enable aio test cases"
       build_select LIBAIO

endif

endmenu
```

## make/Kconfig
```kconfig
menu "Make"

config MAKE
	package "Make"

if MAKE

config MAKE_SRCDIR
       srcdir "Source directory"
       default "make-*"

endif

endmenu
```

## mdadm/Kconfig
```kconfig
menu "Mdadm"

config MDADM
	package "Mdadm tool"

if MDADM

config MDADM_SRCDIR
       srcdir "Source directory"
       default "mdadm-*"

endif

endmenu
```
